/**
 * Tape Master v2 - OLED Display Implementation (SSD1306 / SH1106 128x64)
 * 
 * Author: Alessio Iodice <alessio67@gmail.com>
 * License: CC BY-NC-SA 4.0
 */

#include "oled_display.h"
#include "../config/hardware_pins.h"
#include "pico/stdlib.h"
#include "hardware/i2c.h"
#include <string.h>
#include <stdarg.h>
#include <stdio.h>
#include <stdlib.h>

// Internal Framebuffer: 128 cols * 8 pages (64 bits high) = 1024 bytes
static uint8_t s_framebuffer[OLED_WIDTH * (OLED_HEIGHT / 8)];

// Basic 5x7 Font for ASCII 32 to 127
static const uint8_t font5x7[][5] = {
    {0x00, 0x00, 0x00, 0x00, 0x00}, // (space)
    {0x00, 0x00, 0x5F, 0x00, 0x00}, // !
    {0x00, 0x07, 0x00, 0x07, 0x00}, // "
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    {0x08, 0x08, 0x2A, 0x1C, 0x08}  // ~
};

static void oled_write_cmd(uint8_t cmd) {
    uint8_t buf[2] = {0x00, cmd}; // Co = 0, D/C# = 0
    i2c_write_blocking(I2C_PORT, OLED_I2C_ADDR, buf, 2, false);
}

bool oled_init(void) {
    i2c_init(I2C_PORT, I2C_BAUDRATE_HZ);
    gpio_set_function(PIN_I2C_SDA, GPIO_FUNC_I2C);
    gpio_set_function(PIN_I2C_SCL, GPIO_FUNC_I2C);
    gpio_pull_up(PIN_I2C_SDA);
    gpio_pull_up(PIN_I2C_SCL);

    sleep_ms(20);

    // Standard SSD1306 Initialization sequence for 128x64 display
    oled_write_cmd(0xAE); // Display OFF
    oled_write_cmd(0xD5); // Set Display Clock Divide Ratio
    oled_write_cmd(0x80); // Default ratio
    oled_write_cmd(0xA8); // Set Multiplex Ratio
    oled_write_cmd(0x3F); // 64MUX (1/64 duty)
    oled_write_cmd(0xD3); // Set Display Offset
    oled_write_cmd(0x00); // 0 offset
    oled_write_cmd(0x40); // Set Display Start Line (0)
    oled_write_cmd(0x8D); // Charge Pump Setting
    oled_write_cmd(0x14); // Enable charge pump
    oled_write_cmd(0x20); // Memory Addressing Mode
    oled_write_cmd(0x00); // Horizontal addressing mode
    oled_write_cmd(0xA1); // Segment re-map (A1 = column 127 mapped to SEG0)
    oled_write_cmd(0xC8); // COM Output Scan Direction (remapped mode)
    oled_write_cmd(0xDA); // COM Pins Hardware Configuration
    oled_write_cmd(0x12); // Alternative COM pin config
    oled_write_cmd(0x81); // Set Contrast Control
    oled_write_cmd(0xCF); // High contrast
    oled_write_cmd(0xD9); // Set Pre-charge Period
    oled_write_cmd(0xF1);
    oled_write_cmd(0xDB); // Set VCOMH Deselect Level
    oled_write_cmd(0x40);
    oled_write_cmd(0xA4); // Entire Display ON (Resume from RAM)
    oled_write_cmd(0xA6); // Normal Display (Non-inverted)
    oled_write_cmd(0xAF); // Display ON

    oled_clear();
    oled_update();
    return true;
}

void oled_clear(void) {
    memset(s_framebuffer, 0x00, sizeof(s_framebuffer));
}

void oled_update(void) {
    // Set Column address 0..127
    oled_write_cmd(0x21);
    oled_write_cmd(0);
    oled_write_cmd(OLED_WIDTH - 1);

    // Set Page address 0..7
    oled_write_cmd(0x22);
    oled_write_cmd(0);
    oled_write_cmd((OLED_HEIGHT / 8) - 1);

    // Stream 1024 bytes with Data control byte (0x40) in chunks
    uint8_t chunk[33];
    chunk[0] = 0x40; // Co = 0, D/C# = 1 (Data)

    for (int i = 0; i < sizeof(s_framebuffer); i += 32) {
        memcpy(&chunk[1], &s_framebuffer[i], 32);
        i2c_write_blocking(I2C_PORT, OLED_I2C_ADDR, chunk, 33, false);
    }
}

void oled_draw_pixel(int16_t x, int16_t y, bool color) {
    if (x < 0 || x >= OLED_WIDTH || y < 0 || y >= OLED_HEIGHT) return;
    int page = y / 8;
    int bit = y % 8;
    int idx = page * OLED_WIDTH + x;

    if (color) {
        s_framebuffer[idx] |= (1u << bit);
    } else {
        s_framebuffer[idx] &= ~(1u << bit);
    }
}

void oled_draw_line(int16_t x0, int16_t y0, int16_t x1, int16_t y1, bool color) {
    int16_t dx = abs(x1 - x0), sx = x0 < x1 ? 1 : -1;
    int16_t dy = -abs(y1 - y0), sy = y0 < y1 ? 1 : -1;
    int16_t err = dx + dy, e2;

    for (;;) {
        oled_draw_pixel(x0, y0, color);
        if (x0 == x1 && y0 == y1) break;
        e2 = 2 * err;
        if (e2 >= dy) { err += dy; x0 += sx; }
        if (e2 <= dx) { err += dx; y0 += sy; }
    }
}

void oled_draw_rect(int16_t x, int16_t y, int16_t w, int16_t h, bool filled, bool color) {
    if (filled) {
        for (int16_t i = x; i < x + w; i++) {
            for (int16_t j = y; j < y + h; j++) {
                oled_draw_pixel(i, j, color);
            }
        }
    } else {
        oled_draw_line(x, y, x + w - 1, y, color);
        oled_draw_line(x, y + h - 1, x + w - 1, y + h - 1, color);
        oled_draw_line(x, y, x, y + h - 1, color);
        oled_draw_line(x + w - 1, y, x + w - 1, y + h - 1, color);
    }
}

void oled_draw_progress_bar(int16_t x, int16_t y, int16_t w, int16_t h, uint8_t percent) {
    if (percent > 100) percent = 100;
    oled_draw_rect(x, y, w, h, false, true);
    int16_t inner_w = ((w - 4) * percent) / 100;
    if (inner_w > 0) {
        oled_draw_rect(x + 2, y + 2, inner_w, h - 4, true, true);
    }
}

void oled_draw_char(int16_t x, int16_t y, char c, bool color) {
    if (c < 32 || c > 126) c = '?';
    const uint8_t *glyph = font5x7[c - 32];

    for (int col = 0; col < 5; col++) {
        uint8_t line = glyph[col];
        for (int row = 0; row < 7; row++) {
            if ((line >> row) & 0x01) {
                oled_draw_pixel(x + col, y + row, color);
            }
        }
    }
}

void oled_draw_string(int16_t x, int16_t y, const char *str, bool color) {
    while (*str) {
        oled_draw_char(x, y, *str++, color);
        x += 6; // 5 pixels width + 1 pixel inter-character spacing
        if (x + 5 >= OLED_WIDTH) break;
    }
}

void oled_draw_string_formatted(int16_t x, int16_t y, bool color, const char *fmt, ...) {
    char buf[64];
    va_list args;
    va_start(args, fmt);
    vsnprintf(buf, sizeof(buf), fmt, args);
    va_end(args);
    oled_draw_string(x, y, buf, color);
}

void oled_set_contrast(uint8_t contrast) {
    oled_write_cmd(0x81);
    oled_write_cmd(contrast);
}

void oled_set_display_on(bool on) {
    oled_write_cmd(on ? 0xAF : 0xAE);
}
